## Kconfig
```kconfig
if MACH_XIAOMI_E10
source "techpack/mi845/input/Kconfig"
source "techpack/mi845/amplifier/Kconfig"
endif # MACH_XIAOMI_E10
```

## amplifier/Kconfig
```kconfig
menu "Audio Power Amplifier"
	depends on SND_SOC

config SND_SOC_TAS2559
	tristate "Texas Instruments TAS2559 speaker amplifier"
	depends on I2C

endmenu
```

## input/Kconfig
```kconfig
source "techpack/mi845/input/fingerprint/Kconfig"
source "techpack/mi845/input/touchscreen/Kconfig"
```

## input/touchscreen/Kconfig
```kconfig
menu "Touchscreen"
	depends on INPUT_TOUCHSCREEN

source "techpack/mi845/input/touchscreen/nt36xxx/Kconfig"

endmenu
```
